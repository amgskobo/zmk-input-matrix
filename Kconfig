## Kconfig
```kconfig
# Copyright (c) 2025-2026 amgskobo
# SPDX-License-Identifier: MIT

DT_COMPAT_ZMK_INPUT_PROCESSOR_MATRIX := zmk,input-processor-matrix
DT_COMPAT_ZMK_KSCAN_INPUT_MATRIX := zmk,kscan-input-matrix

config ZMK_INPUT_PROCESSOR_MATRIX
    bool "Input Processor Matrix"
    default $(dt_compat_enabled,$(DT_COMPAT_ZMK_INPUT_PROCESSOR_MATRIX))
    depends on ZMK_POINTING
    depends on (!ZMK_SPLIT || ZMK_SPLIT_ROLE_CENTRAL)
    help
      Enable the ZMK Input Processor Matrix (ZIP Matrix).
      This processor converts absolute trackpad coordinates into virtual key
      events based on gestures (Tap, Flick Up/Down/Left/Right).

config ZMK_KSCAN_INPUT_MATRIX
    bool "KSCAN Input Matrix Proxy"
    default $(dt_compat_enabled,$(DT_COMPAT_ZMK_KSCAN_INPUT_MATRIX))
    select KSCAN
    help
      Enable the KSCAN proxy driver for the Input Processor Matrix.
      This virtual KSCAN device receives events from the ZIP Matrix processor
      and reports them as standard matrix events.

config ZMK_INPUT_MATRIX_MAX_CLAIMS
    int "Maximum simultaneous source claims per virtual matrix"
    depends on ZMK_KSCAN_INPUT_MATRIX
    range 1 255
    default 16
    help
      Bounds the active ownership list, including transient taps. Additional
      claims fail atomically; accepted owners always retain their release.

config ZMK_INPUT_MATRIX_EVENT_QUEUE_SIZE
    int "Virtual matrix ordered edge capacity"
    depends on ZMK_KSCAN_INPUT_MATRIX
    range 2 1024
    default 32
    help
      Bounds pending callbacks plus reserved final releases. A new unoccupied
      cell requires two free entries. Callbacks run outside spinlocks; reentry
      and concurrent producers append in order without blocking or allocation.

config ZMK_INPUT_MATRIX_CUSTOM_SETTINGS
    bool "Publish matrix tuning through zmk-feature-custom-settings"
    depends on ZMK_INPUT_PROCESSOR_MATRIX
    depends on ZMK_CUSTOM_SETTINGS_STUDIO_RPC
    help
      Publishes the enable switch, flick threshold, long-press delay and input
      suppression flags through the shared custom-settings registry. The
      registry owns persistence; the processor keeps only the live values.

config ZMK_INPUT_MATRIX_LOG_LEVEL
    int "zmk-input-matrix log level (0 off, 1 error, 2 warning, 3 info, 4 debug)"
    range 0 4
    default 3
    help
      Logs contain operational state and numeric diagnostics, never input
      contents, user labels, peer addresses or authentication material.
```

## dts/bindings/zmk,input-processor-matrix.yaml
```yaml
description: ZMK Input Processor - Gesture Grid & Flick Recognition

compatible: "zmk,input-processor-matrix"

include: ip_zero_param.yaml

properties:
  rows:
    type: int
    required: true
    description: Number of rows in the gesture grid. Must be 1 to 51.
  columns:
    type: int
    required: true
    description: Number of columns in the gesture grid. Must be 1 to 255.
  x:
    type: int
    required: true
    description: Maximum X coordinate resolution (range is 0 to x). Must be 1 to 65534.
  y:
    type: int
    required: true
    description: Maximum Y coordinate resolution (range is 0 to y). Must be 1 to 65534.
  flick-threshold:
    type: int
    required: true
    description: |
      Minimum travel from the touch origin to register a flick, in pixels.
      Must be 1 to 65535.
      Travel is measured as true distance, so the threshold describes a circle
      around the origin rather than a square: a diagonal stroke qualifies at the
      same length as a straight one.
      A contact keeps being followed after it qualifies, and the direction is
      read from the farthest point it reaches - the first sample past the
      threshold is the shortest vector of the whole stroke and the least
      reliable one to take a direction from.
      The long-press timer is canceled when the contact first qualifies, and the
      flick is reported as press+release on BTN_TOUCH release.
  suppress-abs:
    type: boolean
    description: |
      If true, consume all INPUT_EV_ABS events seen by this processor, not only
      INPUT_ABS_X and INPUT_ABS_Y. This prevents ABS pointer events from reaching
      later processors or the mouse HID.
  suppress-touch:
    type: boolean
    description: |
      If true, consume only INPUT_BTN_TOUCH after this processor updates its
      internal touch state. Other INPUT_EV_KEY events, such as button gestures
      emitted by the touchpad driver, continue downstream.
  suppress-key:
    type: boolean
    description: |
      If true, consume all INPUT_EV_KEY events seen by this processor, not only
      INPUT_BTN_TOUCH. This prevents KEY events from reaching later processors or
      behaviors.
  kscan:
    type: phandle
    required: true
    description: Phandle to the zmk,kscan-input-matrix proxy device to report gesture events.
  long-press-ms:
    type: int
    required: false
    default: 200
    description: |
      Milliseconds after BTN_TOUCH before the kscan cell is pressed (HOLD).
      Hold applies to the Tap block only. If a flick is latched before the timeout,
      the hold timer is canceled and the flick is reported as press+release on
      BTN_TOUCH release.
      The tap-hold cell stays pressed until BTN_TOUCH is released, or until the
      active layer changes - a layer change reroutes the release that would
      otherwise never reach this processor, so the cell is released there too.
      Set to 0 to disable tap hold; taps and flicks are still reported as
      press+release pairs.
  diamond-tap:
    type: boolean
    description: |
      If true, use diamond (diagonal) partitioning instead of the regular
      rectangular grid. Requires rows = 1 and columns = 4.
      The four diagonal quadrants map to:
        col 0 = Up, col 1 = Right, col 2 = Down, col 3 = Left.
      Points on a diagonal boundary prefer the vertical axis, so exact center
      maps to Down.
      Such an instance reports taps only. A diamond takes its direction from
      where the finger comes to rest, which is the opposite of what a flick
      measures: on a small pad a stroke has to begin on the far side of the one
      it travels towards, leaving the two readings pointing opposite ways.
      The kscan proxy behind a diamond instance therefore needs one row per grid
      row instead of five, since the four flick rows are never reached.
```

## tests/deep-scan/Kconfig
```kconfig
# SPDX-License-Identifier: MIT
rsource "../kernel/module/Kconfig"

# Optional, explicitly selected producer checkout; never fetch a dependency.
osource "$(MATRIX_TEST_IQS_ROOT)/Kconfig"
config MATRIX_IQS_SOURCE_TEST
    bool "Actual IQS click producer in Matrix native fixture"
    depends on IQS7211E

config MATRIX_IQS_INLINE_FIRST
    bool "Negative control: emit first IQS edge inline"
    depends on MATRIX_IQS_SOURCE_TEST

config MATRIX_IQS_DROP_RELEASE
    bool "Negative control: omit delivery of the IQS OFF"
    depends on MATRIX_IQS_SOURCE_TEST
```

## tests/integration/config/dya/west.yml
```yaml
# Copyright (c) 2026 The ZMK Input Matrix Contributors
# SPDX-License-Identifier: MIT

manifest:
  remotes:
    - name: cormoran
      url-base: https://github.com/cormoran
  projects:
    - name: zmk
      remote: cormoran
      revision: main+dya
      import: app/west.yml
      clone-depth: 1
    - name: zmk-feature-custom-settings
      remote: cormoran
      revision: main
      clone-depth: 1
  self:
    path: config
```

## tests/integration/firmware/boards/shields/matrix_test/Kconfig.defconfig
```kconfig
# Copyright (c) 2026 amgskobo
# SPDX-License-Identifier: MIT

if SHIELD_MATRIX_TEST

config ZMK_KEYBOARD_NAME
    default "Matrix Test"

endif
```

## tests/integration/firmware/boards/shields/matrix_test/Kconfig.shield
```kconfig
# Copyright (c) 2026 amgskobo
# SPDX-License-Identifier: MIT

config SHIELD_MATRIX_TEST
    def_bool $(shields_list_contains,matrix_test)
```

## tests/kernel/module/Kconfig
```kconfig
# Copyright (c) 2026 amgskobo
# SPDX-License-Identifier: MIT
config MATRIX_KERNEL_TEST
    bool "Matrix work and release boundary fixture"
    depends on ZMK_INPUT_PROCESSOR_MATRIX
```

## tests/source-limits/module/Kconfig
```kconfig
# SPDX-License-Identifier: MIT
config MATRIX_SOURCE_TEST_LEFT
    int "Expected actual left listener index"
    default 0
config MATRIX_SOURCE_TEST_RIGHT
    int "Expected actual right listener index"
    default 1
```

## drivers/input/Kconfig
```kconfig
config ZMK_INPUT_PROCESSOR_GRID_MATRIX
    bool "ZMK Input Processor - Trackpad to 3x3 Grid Layer Controller"
    help
      Enables an input processor that converts trackpad absolute coordinate
      events into a 3x3 grid layer controller. Maps each grid cell to a
      ZMK layer (Layers 6-14).
      
      The processor divides the 0-1024 coordinate space into a 3x3 matrix,
      detecting touch by coordinate presence. It uses an 80ms watchdog timer
      to simulate finger lift and deactivate layers.
```

## dts/bindings/input/processors/zmk,input-processor-grid-matrix.yaml
```yaml
description: |
  ZMK Input Processor - Trackpad to 3x3 Grid Layer Controller

  Converts trackpad absolute coordinate events (EV_ABS) into a 3x3 grid
  layer controller. The 0-1024 coordinate space is divided into a 3x3 matrix,
  with each cell mapped to a ZMK layer (6-14).

  Touch is detected by coordinate updates. An 80ms watchdog deactivates
  the layer when no new coordinates arrive (simulating finger lift).

compatible: "zmk,input-processor-grid-matrix"

properties:
  "#input-processor-cells":
    const: 0
```

## dts/bindings/zmk,kscan-input-matrix.yaml
```yaml
description: |
  ZMK KSCAN Input Matrix (Gesture Matrix Buffer)

  A virtual KSCAN device that reports trackpad gesture events as standard
  matrix key presses. The matrix is dynamically sized based on the linked
  input processor configuration:

    Total rows    = 5 * grid_rows  (Tap, Up, Down, Left, Right blocks)
    Total columns = grid_columns

  Each gesture type occupies a contiguous block of `grid_rows` rows,
  preserving the physical grid shape within each block for intuitive
  ZMK Studio configuration.

  Example (3x3 Grid):
    Rows 0-2:   Tap block     (3x3 zones)
    Rows 3-5:   Up block      (3x3 zones)
    Rows 6-8:   Down block    (3x3 zones)
    Rows 9-11:  Left block    (3x3 zones)
    Rows 12-14: Right block   (3x3 zones)

compatible: "zmk,kscan-input-matrix"

include: kscan.yaml

properties:
  "#kscan-cells":
    type: int
    const: 2
    description: |
      Standard KSCAN cell specifier. Always 2 for (row, column) matrix addressing.
  rows:
    type: int
    required: false
    default: 5
    description: |
      Total number of rows in the virtual matrix.
      When used with input_processor, this must match (5 * grid_rows).
  columns:
    type: int
    required: false
    default: 1
    description: |
      Number of columns in the virtual matrix.
      When used with input_processor, this must match (grid_columns).
```

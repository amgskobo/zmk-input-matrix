/*
 * Copyright (c) 2025 The ZMK Contributors
 * SPDX-License-Identifier: MIT
 */

/ {
    zip_matrix: input_processor_matrix {
        compatible = "zmk,input-processor-matrix";
        #input-processor-cells = <0>;
    };
};

/*
 * Copyright (c) 2025 The ZMK Contributors
 * SPDX-License-Identifier: MIT
 */

/ {
    zip_matrix: input_processor_matrix {
        compatible = "zmk,input-processor-matrix";
        #input-processor-cells = <0>;

        rows = <1>;
        cols = <1>;
        flick-threshold = <250>;
        x = <1024>;
        y = <1024>;
    };
};

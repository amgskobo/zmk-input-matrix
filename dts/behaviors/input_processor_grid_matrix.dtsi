/*
 * Copyright (c) 2025 The ZMK Contributors
 * SPDX-License-Identifier: MIT
 */

/ {
    input_processor_grid_matrix_0: input_processor_grid_matrix {
        compatible = "zmk,input-processor-grid-matrix";
        #input-processor-cells = <0>;
        status = "okay";
    };
};
